/ {
    keymap {
        fidget {
			label = "Fidget";
			bindings = <
              _oo_   _oo_   _oo_   _oo_   _oo_   _oo_                                   _oo_   _oo_   _oo_   _oo_   _oo_   _oo_
              _oo_   _oo_   _oo_   _oo_   _oo_   _oo_                                   _oo_   _oo_   _oo_   _oo_   _oo_   _oo_
              _oo_   _oo_   _oo_   _oo_   _oo_   _oo_   _oo_   _oo_       _oo_   _oo_   _oo_   _oo_   _oo_   _oo_   _oo_   _oo_
                                   _oo_   _oo_   _oo_   _oo_   _oo_       _oo_   _oo_   _oo_   _oo_   _oo_
            >;
        };
    };
};
