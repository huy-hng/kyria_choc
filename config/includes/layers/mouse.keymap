/ {
    keymap {
        mouse {
			label = "Mouse";
			bindings = <
//                ╭─────┬─────┬────────────────┬────────────────┬────────────────┬─────╮                           ╭────────────────┬────────────────┬──────────────┬────────────────┬─────┬─────╮
//                │     │ --- │      ---       │  &mmv MOVE_up  │      ---       │     │                           │                │      ---       │     mbck     │      mfwd      │ --- │     │
//                ├─────┼─────┼────────────────┼────────────────┼────────────────┼─────┤                           ├────────────────┼────────────────┼──────────────┼────────────────┼─────┼─────┤
//                │     │ --- │ &mmv MOVE_left │ &mmv MOVE_down │ &mmv MOVE_rght │ --- │                           │      ---       │      lclk      │     mclk     │      rclk      │ --- │     │
//                ├─────┼─────┼────────────────┼────────────────┼────────────────┼─────┼─────┬─────╮   ╭─────┬─────┼────────────────┼────────────────┼──────────────┼────────────────┼─────┼─────┤
//                │     │ --- │      ---       │      ---       │      ---       │     │     │     │   │     │     │ &msc SCRL_left │ &msc SCRL_down │ &msc SCRL_up │ &msc SCRL_rght │ --- │     │
//                ╰─────┴─────┴────────────────┼────────────────┼────────────────┼─────┼─────┼─────┤   ├─────┼─────┼────────────────┼────────────────┼──────────────┼────────────────┴─────┴─────╯
//                                             │                │                │     │     │     │   │     │     │                │                │              │
//                                             ╰────────────────┴────────────────┴─────┴─────┴─────╯   ╰─────┴─────┴────────────────┴────────────────┴──────────────╯
              ____   _oo_   _oo_             &mmv MOVE_UP     _oo_              ____                                   ____             _oo_             &mkp MB4       &mkp MB5          _oo_   ____
              ____   _oo_   &mmv MOVE_LEFT   &mmv MOVE_DOWN   &mmv MOVE_RIGHT   _oo_                                   _oo_             &mkp LCLK        &mkp MCLK      &mkp RCLK         _oo_   ____
              ____   _oo_   _oo_             _oo_             _oo_              ____   ____   ____       ____   ____   &msc SCRL_LEFT   &msc SCRL_DOWN   &msc SCRL_UP   &msc SCRL_RIGHT   _oo_   ____
                                             ____             ____              ____   ____   ____       ____   ____   ____             ____             ____
            >;
        };
    };
};
